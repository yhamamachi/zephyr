/*
 * Copyright (c) 2023 EPAM Systems
 *
 * SPDX-License-Identifier: Apache-2.0
 *
 */

/dts-v1/;
#include <mem.h>
#include <arm64/renesas/r8a779f.dtsi>
#include "s4sk-pinctrl.dtsi"

/ {
	model = "S4SK (S4)";
	chosen {
		zephyr,sram = &ram;
	};

	ram: memory@48000000 {
		device_type = "mmio-sram";
		reg = <0x0 0x48000000 0x0 DT_SIZE_M(512)>;
	};
};

