## boards/arm64/rcar_s4sk/Kconfig.board
```kconfig
# Copyright (c) 2023 EPAM Systems
# SPDX-License-Identifier: Apache-2.0

config BOARD_RCAR_S4SK
	bool "Renesas S4SK"
	depends on SOC_R8A779F
```

## boards/arm64/rcar_s4sk/Kconfig.defconfig
```kconfig
# Copyright (c) 2023 EPAM Systems
# SPDX-License-Identifier: Apache-2.0

if BOARD_RCAR_S4SK

config BOARD
	default "rcar_s4sk"

config BUILD_OUTPUT_BIN
	default y

endif # BOARD_RCAR_S4SK
```

## boards/shields/xen_dom0/Kconfig.shield
```kconfig
# Copyright (c) 2023 EPAM Systems, Inc
# SPDX-License-Identifier: Apache-2.0

config SHIELD_XEN_DOM0
	def_bool $(shields_list_contains,xen_dom0)
	depends on ARMV8_A
	select XEN_INITIAL_DOMAIN
```

## drivers/xen/Kconfig
```kconfig
# SPDX-License-Identifier: Apache-2.0
# Copyright (c) 2022 EPAM Systems

if SOC_XENVM || SHIELD_XEN_DOM0

menu "Xen drivers"

config XEN_INITIAL_DOMAIN
	bool "Zephyr as Xen Domain 0"
	default n
	help
	  Built binary will be used as Xen privileged domain.

config XEN_REGIONS
	bool "Xen extended regions driver"
	default y
	select SYS_MEM_BLOCKS
	help
	  Xen extended regions driver. Allows using extended regions, provided by
	  XEN hypervisor to Zephyr. This memory can be used to avoid allocations
	  in Zephyr heap memory and using provided extended regions.

config XEN_GRANT_TABLE
	bool "Xen grant table driver"
	depends on HEAP_MEM_POOL_SIZE > 0 || XEN_REGIONS
	default y
	help
	  Xen grant table driver. Please note that driver uses dynamic memory
	  allocation with k_malloc(), so CONFIG_HEAP_MEM_POOL_SIZE should be
	  >= number of pages, that you want to alloc and grant or foreign frames
	  that you want to map.

config XEN_GRANT_TABLE_INIT_PRIORITY
	int "Grant table driver init priority"
	depends on XEN_GRANT_TABLE
	default 50

endmenu

endif # SOC_XENVM || SHIELD_XEN_DOM0
```
