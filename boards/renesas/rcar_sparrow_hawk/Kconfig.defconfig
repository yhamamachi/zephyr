## boards/renesas/rcar_sparrow_hawk/Kconfig.defconfig
```kconfig
# Copyright (c) 2025 Renesas Electronics Corporation
# SPDX-License-Identifier: Apache-2.0

config BUILD_OUTPUT_BIN
	default y if BOARD_RCAR_SPARROW_HAWK_R8A779G3_R52
	default y if BOARD_RCAR_SPARROW_HAWK_R8A779G3_A76
```

## boards/renesas/rcar_sparrow_hawk/Kconfig.rcar_sparrow_hawk
```kconfig
# Copyright (c) 2023 IoT.bzh
# SPDX-License-Identifier: Apache-2.0

config BOARD_RCAR_SPARROW_HAWK
	select SOC_R8A779G3_R52 if BOARD_RCAR_SPARROW_HAWK_R8A779G3_R52
```

## boards/renesas/rcar_sparrow_hawk/board.yml
```yaml
board:
  name: rcar_sparrow_hawk
  full_name: Sparrow Hawk
  vendor: retronix
  socs:
  - name: r8a779g3
```

## dts/bindings/clock/renesas,r8a779g3-cpg-mssr.yaml
```yaml
# Copyright (c) 2025 Renesas Electronics Corporation
# SPDX-License-Identifier: Apache-2.0

description: Renesas R8A779G3 SoC Clock Pulse Generator / Module Standby and Software Reset

compatible: "renesas,r8a779g3-cpg-mssr"

include: renesas,rcar-cpg-mssr.yaml
```

## fit-image.its
```
/dts-v1/;

/ {
	description = "Zephyr and bl31 for r8a779g3-sparrow-hawk";

	images {
		kernel-1 {
			description = "Zephyr";
			data = /incbin/("./_work/zephyr/build/zephyr/zephyr.bin");
			arch = "arm64";
			type = "kernel";
			os = "linux";
			compression = "none";
			load = <0x40000000>;
			entry = <0x40000000>;
			hash-1 {
				algo = "crc32";
			};
		};
		fdt-1 {
			description = "Flattened Device Tree blob";
			data = /incbin/("./_work/zephyr/build/zephyr/zephyr.dtb");
			type = "flat_dt";
			arch = "arm64";
			compression = "none";
			load = <0x50000000>;
			hash-1 {
				algo = "crc32";
			};
		};
		atf-1 {
			description = "ARM Trusted Firmware";
			data = /incbin/("./bl31-sparrow-hawk.bin");
			type = "tfa-bl31";
			arch = "arm64";
			os = "arm-trusted-firmware";
			compression = "none";
			load = <0x46400000>;
			entry = <0x46400000>;
			hash-1 {
				algo = "crc32";
			};
		};
	};

	configurations {
		default = "default";
		default {
			description = "Boot Zephyr";
			kernel = "kernel-1";
			fdt = "fdt-1";
			loadables = "atf-1";
			hash-1 {
				algo = "crc32";
			};
		};
	};
};
```
